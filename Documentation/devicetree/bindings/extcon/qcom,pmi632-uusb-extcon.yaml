## Documentation/devicetree/bindings/media/qcom,sdm439-camss.yaml
```yaml
# SPDX-License-Identifier: (GPL-2.0-only OR BSD-2-Clause)
%YAML 1.2
---
$id: http://devicetree.org/schemas/media/qcom,sdm439-camss.yaml#
$schema: http://devicetree.org/meta-schemas/core.yaml#

title: Qualcomm SDM429 and SDM439 Camera Subsystem (CAMSS)

maintainers:
  - Yaron Shahrabani <yarons@users.noreply.github.com>

description:
  The CAMSS IP is a CSI decoder and ISP present on Qualcomm platforms. SDM429
  and SDM439 carry the CSI decoders, the ISP interface and the two ISPs of
  MSM8937 behind another CSI-2 receiver. Each of the two CSIPHYs is a pair of
  Synopsys D-PHYs with two data lanes and a clock lane each, PHY A and PHY B,
  which can be combined into one four lane receiver clocked by PHY A.

properties:
  compatible:
    const: qcom,sdm439-camss

  reg:
    minItems: 11
    maxItems: 11

  reg-names:
    items:
      - const: csiphy0
      - const: csiphy0_clk_mux
      - const: csiphy1
      - const: csiphy1_clk_mux
      - const: csid0
      - const: csid1
      - const: csid2
      - const: ispif
      - const: csi_clk_mux
      - const: vfe0
      - const: vfe1

  interrupts:
    minItems: 8
    maxItems: 8

  interrupt-names:
    items:
      - const: csiphy0
      - const: csiphy1
      - const: csid0
      - const: csid1
      - const: csid2
      - const: ispif
      - const: vfe0
      - const: vfe1

  clocks:
    minItems: 29
    maxItems: 29

  clock-names:
    items:
      - const: top_ahb
      - const: ispif_ahb
      - const: micro_ahb
      - const: csiphy0_timer
      - const: csiphy1_timer
      - const: csi0_ahb
      - const: csi0
      - const: csi0_phy
      - const: csi0_pix
      - const: csi0_rdi
      - const: csi1_ahb
      - const: csi1
      - const: csi1_phy
      - const: csi1_pix
      - const: csi1_rdi
      - const: csi2_ahb
      - const: csi2
      - const: csi2_phy
      - const: csi2_pix
      - const: csi2_rdi
      - const: ahb
      - const: vfe0
      - const: csi_vfe0
      - const: vfe_ahb
      - const: vfe_axi
      - const: vfe1
      - const: csi_vfe1
      - const: vfe1_ahb
      - const: vfe1_axi

  iommus:
    maxItems: 1

  power-domains:
    items:
      - description: VFE0 GDSC - Video Front End, Global Distributed Switch Controller.
      - description: VFE1 GDSC - Video Front End, Global Distributed Switch Controller.

  vdda-supply:
    description:
      Definition of the regulator used as analog power supply of the CSI
      decoders.

  ports:
    $ref: /schemas/graph.yaml#/properties/ports

    description:
      CSI input ports, one per CSIPHY.

    patternProperties:
      "^port@[01]$":
        $ref: /schemas/graph.yaml#/$defs/port-base
        unevaluatedProperties: false
        description:
          Input port for receiving CSI data.

        properties:
          endpoint:
            $ref: video-interfaces.yaml#
            unevaluatedProperties: false

            properties:
              clock-lanes:
                description:
                  The clock lane of PHY A. It clocks PHY B as well when all
                  four data lanes are in use.
                const: 4

              data-lanes:
                description:
                  An array of physical data lanes indexes. Position of an
                  entry determines the logical lane number, while the value
                  of an entry indicates physical lane index. Lanes 0 and 1
                  belong to PHY A, lanes 2 and 3 to PHY B. One or two lanes
                  have to be those of PHY A.
                oneOf:
                  - minItems: 1
                    maxItems: 2
                    items:
                      enum: [0, 1]
                  - minItems: 4
                    maxItems: 4
                    items:
                      enum: [0, 1, 2, 3]

            required:
              - clock-lanes
              - data-lanes

required:
  - compatible
  - reg
  - reg-names
  - interrupts
  - interrupt-names
  - clocks
  - clock-names
  - iommus
  - power-domains
  - vdda-supply
  - ports

additionalProperties: false

examples:
  - |
    #include <dt-bindings/clock/qcom,gcc-msm8917.h>
    #include <dt-bindings/interrupt-controller/arm-gic.h>

    camss@1b00000 {
        compatible = "qcom,sdm439-camss";
        reg = <0x01b34000 0x1000>,
              <0x01b00030 0x4>,
              <0x01b35000 0x1000>,
              <0x01b00038 0x4>,
              <0x01b30000 0x100>,
              <0x01b30400 0x100>,
              <0x01b30800 0x100>,
              <0x01b31000 0x500>,
              <0x01b00020 0x10>,
              <0x01b10000 0x1000>,
              <0x01b14000 0x1000>;
        reg-names = "csiphy0",
                    "csiphy0_clk_mux",
                    "csiphy1",
                    "csiphy1_clk_mux",
                    "csid0",
                    "csid1",
                    "csid2",
                    "ispif",
                    "csi_clk_mux",
                    "vfe0",
                    "vfe1";
        interrupts = <GIC_SPI 78 IRQ_TYPE_EDGE_RISING>,
                     <GIC_SPI 79 IRQ_TYPE_EDGE_RISING>,
                     <GIC_SPI 51 IRQ_TYPE_EDGE_RISING>,
                     <GIC_SPI 52 IRQ_TYPE_EDGE_RISING>,
                     <GIC_SPI 153 IRQ_TYPE_EDGE_RISING>,
                     <GIC_SPI 55 IRQ_TYPE_EDGE_RISING>,
                     <GIC_SPI 57 IRQ_TYPE_EDGE_RISING>,
                     <GIC_SPI 29 IRQ_TYPE_EDGE_RISING>;
        interrupt-names = "csiphy0",
                          "csiphy1",
                          "csid0",
                          "csid1",
                          "csid2",
                          "ispif",
                          "vfe0",
                          "vfe1";
        power-domains = <&gcc VFE0_GDSC>, <&gcc VFE1_GDSC>;
        clocks = <&gcc GCC_CAMSS_TOP_AHB_CLK>,
                 <&gcc GCC_CAMSS_ISPIF_AHB_CLK>,
                 <&gcc GCC_CAMSS_MICRO_AHB_CLK>,
                 <&gcc GCC_CAMSS_CSI0PHYTIMER_CLK>,
                 <&gcc GCC_CAMSS_CSI1PHYTIMER_CLK>,
                 <&gcc GCC_CAMSS_CSI0_AHB_CLK>,
                 <&gcc GCC_CAMSS_CSI0_CLK>,
                 <&gcc GCC_CAMSS_CSI0PHY_CLK>,
                 <&gcc GCC_CAMSS_CSI0PIX_CLK>,
                 <&gcc GCC_CAMSS_CSI0RDI_CLK>,
                 <&gcc GCC_CAMSS_CSI1_AHB_CLK>,
                 <&gcc GCC_CAMSS_CSI1_CLK>,
                 <&gcc GCC_CAMSS_CSI1PHY_CLK>,
                 <&gcc GCC_CAMSS_CSI1PIX_CLK>,
                 <&gcc GCC_CAMSS_CSI1RDI_CLK>,
                 <&gcc GCC_CAMSS_CSI2_AHB_CLK>,
                 <&gcc GCC_CAMSS_CSI2_CLK>,
                 <&gcc GCC_CAMSS_CSI2PHY_CLK>,
                 <&gcc GCC_CAMSS_CSI2PIX_CLK>,
                 <&gcc GCC_CAMSS_CSI2RDI_CLK>,
                 <&gcc GCC_CAMSS_AHB_CLK>,
                 <&gcc GCC_CAMSS_VFE0_CLK>,
                 <&gcc GCC_CAMSS_CSI_VFE0_CLK>,
                 <&gcc GCC_CAMSS_VFE0_AHB_CLK>,
                 <&gcc GCC_CAMSS_VFE0_AXI_CLK>,
                 <&gcc GCC_CAMSS_VFE1_CLK>,
                 <&gcc GCC_CAMSS_CSI_VFE1_CLK>,
                 <&gcc GCC_CAMSS_VFE1_AHB_CLK>,
                 <&gcc GCC_CAMSS_VFE1_AXI_CLK>;
        clock-names = "top_ahb",
                      "ispif_ahb",
                      "micro_ahb",
                      "csiphy0_timer",
                      "csiphy1_timer",
                      "csi0_ahb",
                      "csi0",
                      "csi0_phy",
                      "csi0_pix",
                      "csi0_rdi",
                      "csi1_ahb",
                      "csi1",
                      "csi1_phy",
                      "csi1_pix",
                      "csi1_rdi",
                      "csi2_ahb",
                      "csi2",
                      "csi2_phy",
                      "csi2_pix",
                      "csi2_rdi",
                      "ahb",
                      "vfe0",
                      "csi_vfe0",
                      "vfe_ahb",
                      "vfe_axi",
                      "vfe1",
                      "csi_vfe1",
                      "vfe1_ahb",
                      "vfe1_axi";
        iommus = <&apps_iommu 0x14>;
        vdda-supply = <&pm8953_l23>;

        ports {
            #address-cells = <1>;
            #size-cells = <0>;

            port@0 {
                reg = <0>;

                endpoint {
                    clock-lanes = <4>;
                    data-lanes = <0 1 2 3>;
                    remote-endpoint = <&rear_cam_ep>;
                };
            };

            port@1 {
                reg = <1>;

                endpoint {
                    clock-lanes = <4>;
                    data-lanes = <0>;
                    remote-endpoint = <&front_cam_ep>;
                };
            };
        };
    };

...
```

## Documentation/devicetree/bindings/phy/qcom,dsi-phy-12nm.yaml
```yaml
# SPDX-License-Identifier: GPL-2.0-only OR BSD-2-Clause
%YAML 1.2
---
$id: http://devicetree.org/schemas/phy/qcom,dsi-phy-12nm.yaml#
$schema: http://devicetree.org/meta-schemas/core.yaml#

title: Qualcomm Display DSI 12nm PHY

maintainers:
  - Krishna Manikandan <quic_mkrishn@quicinc.com>

description:
  DSI PHY and PLL found on SDM429 and SDM439. Unlike on the other Qualcomm DSI
  PHYs the PLL registers do not have a block of their own, they are
  interleaved with the PHY registers, so the dsi_pll and dsi_phy regions
  overlap.

allOf:
  - $ref: qcom,dsi-phy-common.yaml#

properties:
  compatible:
    enum:
      - qcom,dsi-phy-12nm

  reg:
    minItems: 2
    items:
      - description: dsi pll register set
      - description: dsi phy register set
      - description:
          Not part of the PHY and not used. The 12nm PHY has no regulator
          registers. Existing device trees list the MMSS misc block (DSI ULPS
          clamp and PHY reset controls) here under the name that the 28nm PHY
          node they override uses for its regulator registers; the entry is
          only accepted for their sake and should be left out of new ones.

  reg-names:
    minItems: 2
    items:
      - const: dsi_pll
      - const: dsi_phy
      - const: dsi_phy_regulator

  vddio-supply:
    description: Phandle to vdd-io regulator device node.

required:
  - compatible
  - reg
  - reg-names
  - vddio-supply

unevaluatedProperties: false

examples:
  - |
    #include <dt-bindings/clock/qcom,gcc-msm8917.h>
    #include <dt-bindings/clock/qcom,rpmcc.h>

    dsi-phy@1a94400 {
        compatible = "qcom,dsi-phy-12nm";
        reg = <0x01a94400 0x400>,
              <0x01a94400 0x400>;
        reg-names = "dsi_pll",
                    "dsi_phy";

        #clock-cells = <1>;
        #phy-cells = <0>;

        vddio-supply = <&vddio_reg>;

        clocks = <&gcc GCC_MDSS_AHB_CLK>,
                 <&rpmcc RPM_SMD_XO_CLK_SRC>;
        clock-names = "iface", "ref";
    };
...
```

## Documentation/devicetree/bindings/sound/awinic,aw87319.yaml
```yaml
# SPDX-License-Identifier: (GPL-2.0-only OR BSD-2-Clause)
%YAML 1.2
---
$id: http://devicetree.org/schemas/sound/awinic,aw87319.yaml#
$schema: http://devicetree.org/meta-schemas/core.yaml#

title: Awinic AW87319 Audio Amplifier

maintainers:
  - Yaron Shahrabani <yarons@users.noreply.github.com>

description:
  The Awinic AW87319 is a mono class-D speaker amplifier with an integrated
  boost converter and a multi-level AGC. It has an analog input and is
  configured through a handful of I2C registers, there is no digital audio
  interface. The reset pin holds the chip in shutdown while it is low.

allOf:
  - $ref: component-common.yaml#

properties:
  compatible:
    const: awinic,aw87319

  reg:
    maxItems: 1

  reset-gpios:
    description:
      GPIO connected to the reset pin (active low). The chip is in hardware
      shutdown and does not answer on I2C while the line is low.
    maxItems: 1

  sound-name-prefix: true

required:
  - compatible
  - reg

additionalProperties: false

examples:
  - |
    #include <dt-bindings/gpio/gpio.h>
    i2c {
        #address-cells = <1>;
        #size-cells = <0>;

        audio-amplifier@58 {
            compatible = "awinic,aw87319";
            reg = <0x58>;
            reset-gpios = <&tlmm 39 GPIO_ACTIVE_LOW>;
            sound-name-prefix = "Speaker Amp Left";
        };
    };
```
