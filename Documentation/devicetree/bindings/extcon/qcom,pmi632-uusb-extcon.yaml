## Documentation/devicetree/bindings/extcon/qcom,pmi632-uusb-extcon.yaml
```yaml
# SPDX-License-Identifier: (GPL-2.0-only OR BSD-2-Clause)
%YAML 1.2
---
$id: http://devicetree.org/schemas/extcon/qcom,pmi632-uusb-extcon.yaml#
$schema: http://devicetree.org/meta-schemas/core.yaml#

title: Qualcomm SMB5 PMIC micro-USB ID detection

maintainers:
  - Yaron Shahrabani <yarons@users.noreply.github.com>

description:
  On boards with a micro-USB receptacle the Type-C block of Qualcomm PMICs
  with an SMB5 charger, such as PMI632, runs in micro USB mode and reports
  the state of the ID pin. This describes the block in that mode, as an
  extcon provider for USB OTG adapter detection. Boards with a Type-C
  receptacle use qcom,pmi632-typec for the same registers instead.

properties:
  compatible:
    const: qcom,pmi632-uusb-extcon

  reg:
    maxItems: 1

  interrupts:
    items:
      - description: ID state change (the block's or-rid-detect-change interrupt)

required:
  - compatible
  - reg
  - interrupts

additionalProperties: false

examples:
  - |
    #include <dt-bindings/interrupt-controller/irq.h>

    pmic {
        #address-cells = <1>;
        #size-cells = <0>;

        extcon@1500 {
            compatible = "qcom,pmi632-uusb-extcon";
            reg = <0x1500>;
            interrupts = <0x2 0x15 0x00 IRQ_TYPE_EDGE_RISING>;
        };
    };
...
```

## Documentation/devicetree/bindings/media/i2c/galaxycore,gc2375h.yaml
```yaml
# SPDX-License-Identifier: (GPL-2.0-only OR BSD-2-Clause)
%YAML 1.2
---
$id: http://devicetree.org/schemas/media/i2c/galaxycore,gc2375h.yaml#
$schema: http://devicetree.org/meta-schemas/core.yaml#

title: GalaxyCore GC2375H 1/5" 2M Pixel MIPI CSI-2 sensor

maintainers:
  - Yaron Shahrabani <yarons@users.noreply.github.com>

description:
  The GC2375H is a raw image sensor with a 1600x1200 pixel array, a MIPI
  CSI-2 image data interface with one data lane and an I2C compatible
  control bus. The output format is 10 bit raw Bayer.

allOf:
  - $ref: /schemas/media/video-interface-devices.yaml#

properties:
  compatible:
    const: galaxycore,gc2375h

  reg:
    maxItems: 1

  clocks:
    description: Reference to the master clock, 19.2 MHz or 24 MHz.
    maxItems: 1

  dovdd-supply:
    description: Digital I/O supply (IOVDD), 1.8 V.

  avdd-supply:
    description: Analog supply (AVDD), 2.8 V.

  dvdd-supply:
    description:
      Digital core supply (DVDD), 1.8 V. Camera modules may feed it from the
      I/O supply.

  reset-gpios:
    description: Reference to the GPIO connected to the RESETB pin.
    maxItems: 1

  powerdown-gpios:
    description:
      Reference to the GPIO connected to the PWDN pin. The sensor is in
      power down mode while the pin is high.
    maxItems: 1

  port:
    $ref: /schemas/graph.yaml#/$defs/port-base
    additionalProperties: false
    description:
      Output port node, single endpoint describing the CSI-2 transmitter.

    properties:
      endpoint:
        $ref: /schemas/media/video-interfaces.yaml#
        unevaluatedProperties: false

        properties:
          data-lanes:
            items:
              - const: 1

          link-frequencies:
            description:
              364800000 Hz with a 19.2 MHz master clock, 312000000 Hz with a
              24 MHz master clock.

        required:
          - data-lanes
          - link-frequencies

    required:
      - endpoint

required:
  - compatible
  - reg
  - clocks
  - dovdd-supply
  - avdd-supply
  - reset-gpios
  - port

unevaluatedProperties: false

examples:
  - |
    #include <dt-bindings/gpio/gpio.h>

    i2c {
        #address-cells = <1>;
        #size-cells = <0>;

        sensor@17 {
            compatible = "galaxycore,gc2375h";
            reg = <0x17>;

            clocks = <&gc2375h_clk>;

            reset-gpios = <&tlmm 38 GPIO_ACTIVE_LOW>;
            powerdown-gpios = <&tlmm 128 GPIO_ACTIVE_HIGH>;

            avdd-supply = <&gc2375h_avdd>;
            dovdd-supply = <&gc2375h_dovdd>;

            orientation = <0>;
            rotation = <270>;

            port {
                endpoint {
                    data-lanes = <1>;
                    link-frequencies = /bits/ 64 <364800000>;
                    remote-endpoint = <&csiphy1_ep>;
                };
            };
        };
    };

...
```

## Documentation/devicetree/bindings/media/i2c/galaxycore,gc8034.yaml
```yaml
# SPDX-License-Identifier: (GPL-2.0-only OR BSD-2-Clause)
%YAML 1.2
---
$id: http://devicetree.org/schemas/media/i2c/galaxycore,gc8034.yaml#
$schema: http://devicetree.org/meta-schemas/core.yaml#

title: GalaxyCore GC8034 1/4" 8M Pixel MIPI CSI-2 sensor

maintainers:
  - Yaron Shahrabani <yarons@users.noreply.github.com>

description:
  The GC8034 is a raw image sensor with a 3264x2448 pixel array, a MIPI
  CSI-2 image data interface with up to four data lanes and an I2C
  compatible control bus. The output format is 10 bit raw Bayer.

allOf:
  - $ref: /schemas/media/video-interface-devices.yaml#

properties:
  compatible:
    const: galaxycore,gc8034

  reg:
    maxItems: 1

  clocks:
    maxItems: 1

  dovdd-supply:
    description: Digital I/O supply (IOVDD), 1.8 V.

  avdd-supply:
    description: Analog supply (AVDD), 2.8 V.

  dvdd-supply:
    description: Digital core supply (DVDD), 1.2 V.

  vaf-supply:
    description:
      Supply of the voice coil driver of the camera module. The voice coil
      driver shares the I2C bus with the sensor, the supply is kept on
      together with the sensor supplies.

  reset-gpios:
    description: Reference to the GPIO connected to the RESETB pin.
    maxItems: 1

  powerdown-gpios:
    description:
      Reference to the GPIO connected to the PWDNB pin. The sensor is in
      power down mode while the pin is low.
    maxItems: 1

  port:
    $ref: /schemas/graph.yaml#/$defs/port-base
    additionalProperties: false
    description:
      Output port node, single endpoint describing the CSI-2 transmitter.

    properties:
      endpoint:
        $ref: /schemas/media/video-interfaces.yaml#
        unevaluatedProperties: false

        properties:
          data-lanes:
            items:
              - const: 1
              - const: 2
              - const: 3
              - const: 4

          link-frequencies: true

        required:
          - data-lanes
          - link-frequencies

    required:
      - endpoint

required:
  - compatible
  - reg
  - clocks
  - dovdd-supply
  - avdd-supply
  - dvdd-supply
  - reset-gpios
  - port

unevaluatedProperties: false

examples:
  - |
    #include <dt-bindings/gpio/gpio.h>

    i2c {
        #address-cells = <1>;
        #size-cells = <0>;

        sensor@37 {
            compatible = "galaxycore,gc8034";
            reg = <0x37>;

            clocks = <&gc8034_clk>;

            reset-gpios = <&tlmm 36 GPIO_ACTIVE_LOW>;
            powerdown-gpios = <&tlmm 20 GPIO_ACTIVE_LOW>;

            avdd-supply = <&gc8034_avdd>;
            dovdd-supply = <&gc8034_dovdd>;
            dvdd-supply = <&gc8034_dvdd>;

            orientation = <1>;
            rotation = <90>;

            port {
                sensor_out: endpoint {
                    data-lanes = <1 2 3 4>;
                    link-frequencies = /bits/ 64 <336000000 168000000>;
                    remote-endpoint = <&csiphy0_ep>;
                };
            };
        };
    };

...
```

## Documentation/devicetree/bindings/media/i2c/giantec,gt9772.yaml
```yaml
# SPDX-License-Identifier: (GPL-2.0-only OR BSD-2-Clause)
%YAML 1.2
---
$id: http://devicetree.org/schemas/media/i2c/giantec,gt9772.yaml#
$schema: http://devicetree.org/meta-schemas/core.yaml#

title: Giantec GT9772 Voice Coil Motor (VCM) Lens Driver

maintainers:
  - Yaron Shahrabani <yarons@users.noreply.github.com>

description:
  The Giantec GT9772 is a 10 bit digital-to-analog converter with a current
  sink output and ringing control, used to drive the voice coil motor of
  camera lenses. It is controlled over I2C.

properties:
  compatible:
    const: giantec,gt9772

  reg:
    maxItems: 1

  vdd-supply:
    description: Power supply of the driver and the voice coil.

required:
  - compatible
  - reg
  - vdd-supply

additionalProperties: false

examples:
  - |
    i2c {
        #address-cells = <1>;
        #size-cells = <0>;

        lens@c {
            compatible = "giantec,gt9772";
            reg = <0x0c>;
            vdd-supply = <&pm8953_l17>;
        };
    };
...
```
